## prj.conf
```kconfig
# General
CONFIG_MAIN_STACK_SIZE=8192
CONFIG_HEAP_MEM_POOL_SIZE=10240
CONFIG_NEWLIB_LIBC=y
CONFIG_NEWLIB_LIBC_FLOAT_PRINTF=y

# Debugging
# Use one of the following two options if debugging with breakpoints
# CONFIG_NO_OPTIMIZATIONS=y
# CONFIG_DEBUG_OPTIMIZATIONS=y

# App
CONFIG_BLUEGRASS=y
CONFIG_APP_AWS_CUSTOMIZATION=y
CONFIG_COAP_FOTA_BASE64=y
CONFIG_COAP_FOTA_PRODUCT="pinnacle-100-dvk"
CONFIG_SENSOR_TABLE_SIZE=5

# CONFIG_POSIX_API=y 

# App debug
# CONFIG_VSP_TX_ECHO=y
# CONFIG_VSP_RX_ECHO=y

# for more info on JSON 
# CONFIG_JSON_LOG_ENABLED=y  
# CONFIG_JSON_LOG_PUBLISH=y 
# CONFIG_JSON_LOG_TOPIC=y   

# CONFIG_JSON_LOG_MQTT_RX_DATA=y

#CONFIG_BT_SCAN_VERBOSE_ADV_HANDLER=y 

# Bluetooth
CONFIG_BT=y
CONFIG_BT_GATT_DYNAMIC_DB=y
CONFIG_BT_CTLR_TX_PWR_PLUS_8=y
CONFIG_BT_CTLR_COMPANY_ID=0x0077
CONFIG_BT_MAX_CONN=3
CONFIG_BT_CTLR_DATA_LENGTH_MAX=251
CONFIG_BT_CTLR_TX_BUFFER_SIZE=251
CONFIG_BT_L2CAP_TX_MTU=260
CONFIG_BT_RX_BUF_LEN=260
CONFIG_BT_RX_STACK_SIZE=2048
# Allow Coded PHY (requires Nordic Bluetooth host)
CONFIG_BT_EXT_ADV=y
CONFIG_BT_LL_NRFXLIB_VS_INCLUDE=y
CONFIG_BT_LL_NRFXLIB_DEFAULT=y
# BLE Central settings
CONFIG_BT_CENTRAL=y
CONFIG_BT_GATT_CLIENT=y
# Enable simultaneous advertising and scanning
# (zephyr doesn't allow multiple random addresses)
CONFIG_BT_PRIVACY=n
CONFIG_BT_SCAN_WITH_IDENTITY=y
# The BT510 advertises at a 1-second rate (default of 3 seconds is too short)
CONFIG_BT_CREATE_CONN_TIMEOUT=6
# BLE Peripheral settings
CONFIG_BT_PERIPHERAL=y
CONFIG_BT_DEVICE_NAME="MG100"
CONFIG_BT_DEVICE_NAME_DYNAMIC=y
# BLE security
CONFIG_BT_SMP=y
CONFIG_BT_BONDABLE=n
CONFIG_BT_MAX_PAIRED=3
# BLE debug
# CONFIG_BT_DEBUG_LOG=y
# CONFIG_BT_DEBUG_CONN=y
# CONFIG_BT_DEBUG_SMP=y

# modem settings
CONFIG_MODEM=y
CONFIG_MODEM_HL7800=y
CONFIG_MODEM_HL7800_RAT_M1=y
# CONFIG_MODEM_LOG_LEVEL_DBG=y
CONFIG_MODEM_HL7800_FW_UPDATE=y
CONFIG_MODEM_HL7800_RECV_BUF_CNT=64
CONFIG_NET_BUF_RX_COUNT=64

# NETWORKING
CONFIG_NETWORKING=y
CONFIG_NET_IPV4=y
CONFIG_NET_IPV6=n
CONFIG_NET_MGMT=y
CONFIG_NET_MGMT_EVENT=y
CONFIG_NET_SOCKETS=y
CONFIG_NET_SOCKETS_POSIX_NAMES=y
CONFIG_NET_SOCKETS_NET_MGMT=y
CONFIG_NET_SOCKETS_NET_MGMT_MAX_LISTENERS=3
CONFIG_NET_TCP=y
CONFIG_NET_CONFIG_INIT_TIMEOUT=2
CONFIG_NET_SHELL=y
CONFIG_NET_BUF_POOL_USAGE=y
CONFIG_COAP=y
CONFIG_NET_UDP=y

# Enable the DNS resolver
CONFIG_DNS_RESOLVER=y
CONFIG_NET_SOCKETS_DNS_TIMEOUT=10000

# MQTT
CONFIG_MQTT_LIB=y
# Security
CONFIG_MQTT_LIB_TLS=y
CONFIG_NET_SOCKETS_SOCKOPT_TLS=y
CONFIG_NET_SOCKETS_ENABLE_DTLS=y
CONFIG_NET_SOCKETS_TLS_MAX_CONTEXTS=2
CONFIG_TLS_MAX_CREDENTIALS_NUMBER=3
# TLS configuration
CONFIG_MBEDTLS=y
CONFIG_MBEDTLS_DTLS=y
CONFIG_MBEDTLS_BUILTIN=y
CONFIG_MBEDTLS_ENABLE_HEAP=y
CONFIG_MBEDTLS_HEAP_SIZE=55000
CONFIG_MBEDTLS_SSL_MAX_CONTENT_LEN=8192
CONFIG_MBEDTLS_PEM_CERTIFICATE_FORMAT=y
CONFIG_MBEDTLS_KEY_EXCHANGE_PSK_ENABLED=y
# Use format supported by Californium (CoAP bridge) and AWS.
CONFIG_MBEDTLS_KEY_EXCHANGE_ECDHE_ECDSA_ENABLED=y
CONFIG_MBEDTLS_ECP_ALL_ENABLED=y
CONFIG_MBEDTLS_CIPHER_GCM_ENABLED=y

# JSON used by AWS task
CONFIG_JSON_LIBRARY=y

# Storage
CONFIG_NVS=y
CONFIG_MPU_ALLOW_FLASH_WRITE=y
CONFIG_FLASH=y
CONFIG_FCB=y
CONFIG_FLASH_MAP=y
CONFIG_FLASH_PAGE_LAYOUT=y

# Enable mcumgr to support FOTA
CONFIG_MCUMGR=y
CONFIG_MCUMGR_SMP_SHELL=y
CONFIG_MCUMGR_SMP_SHELL_MTU=2048
CONFIG_MCUMGR_BUF_SIZE=2050
CONFIG_MGMT_CBORATTR_MAX_SIZE=2048
CONFIG_FS_MGMT_UL_CHUNK_SIZE=2048
# Enable the Bluetooth (unauthenticated) mcumgr transport.
CONFIG_MCUMGR_SMP_BT=y
CONFIG_MCUMGR_SMP_BT_AUTHEN=n

CONFIG_MCUMGR_CMD_IMG_MGMT=y
CONFIG_MCUMGR_CMD_OS_MGMT=y
CONFIG_MCUMGR_CMD_FS_MGMT=y
# Enable large files at the expense of larger CBOR encoding.
CONFIG_FS_MGMT_MAX_FILE_SIZE_4GB=y
# Some command handlers require a large stack.
CONFIG_SYSTEM_WORKQUEUE_STACK_SIZE=4096

# Enable the LittleFS file system.
CONFIG_FILE_SYSTEM=y
CONFIG_FILE_SYSTEM_LITTLEFS=y

# Enable QSPI (MX25R64)
CONFIG_NORDIC_QSPI_NOR=y
CONFIG_NORDIC_QSPI_NOR_FLASH_LAYOUT_PAGE_SIZE=4096
CONFIG_NORDIC_QSPI_NOR_FLASH_ALLOW_STACK_USAGE_FOR_DATA_IN_FLASH=y
CONFIG_PM_EXTERNAL_FLASH=y
CONFIG_PM_EXTERNAL_FLASH_DEV_NAME="MX25R64"
CONFIG_PM_EXTERNAL_FLASH_SIZE=0x800000
CONFIG_PM_EXTERNAL_FLASH_BASE=0x0

# command line shell
CONFIG_SHELL=y
CONFIG_SHELL_HISTORY=n
CONFIG_KERNEL_SHELL=y
CONFIG_FILE_SYSTEM_SHELL=y
CONFIG_SENSOR_SHELL=n
CONFIG_I2C_SHELL=n

# Log messages
CONFIG_LOG=y
CONFIG_LOG_BUFFER_SIZE=2048
# for logging more dynamic strings
CONFIG_LOG_STRDUP_BUF_COUNT=16
CONFIG_LOG_STRDUP_MAX_STRING=64

# Networking debug
CONFIG_NET_LOG=y
# CONFIG_NET_SOCKETS_LOG_LEVEL_DBG=y
CONFIG_NET_SOCKETS_LOG_LEVEL_ERR=y
CONFIG_MBEDTLS_DEBUG=y
CONFIG_MBEDTLS_DEBUG_LEVEL=1
# CONFIG_NET_MGMT_EVENT_LOG_LEVEL_DBG=y

# Segger debugging tools
# CONFIG_SEGGER_SYSTEMVIEW=y
# CONFIG_USE_SEGGER_RTT=y

# Thread Debug
CONFIG_INIT_STACKS=y
CONFIG_THREAD_ANALYZER=y
CONFIG_THREAD_NAME=y
CONFIG_THREAD_MAX_NAME_LEN=12
#CONFIG_HW_STACK_PROTECTION=y
#CONFIG_STACK_SENTINEL=y
#CONFIG_STACK_CANARIES=y

# ADC for power measurement
CONFIG_ADC=y
CONFIG_ADC_NRFX_SAADC=y
CONFIG_LCZ_ADC_SAMPLE_PERIOD=3
CONFIG_LCZ_ADC_ALWAYS_SAMPLING=y

# Allows rebooting in zephyr
CONFIG_REBOOT=y

# Message Framework
CONFIG_FWK_ASSERT_ENABLED=y
CONFIG_BUFFER_POOL_SIZE=16384

# Laird Connectivity Zephyr
CONFIG_LCZ_AD_FIND=y
CONFIG_LCZ_BT_SCAN=y

CONFIG_BLE_CELLULAR_SERVICE=y
CONFIG_BLE_POWER_SERVICE=y
CONFIG_LCZ_BLE_DIS=y

CONFIG_FILE_SYSTEM_UTILITIES=y
CONFIG_FOTA_SERVICE=y

CONFIG_LCZ_QRTC=y
CONFIG_LCZ_LED=y
CONFIG_LCZ_DNS=y
CONFIG_LCZ_POWER=y
CONFIG_LCZ_SOCK=y
CONFIG_NUMBER_OF_LEDS=3

# SDHC and FAT32 Support
CONFIG_DISK_ACCESS=y
CONFIG_DISK_ACCESS_SDHC=y
CONFIG_DISK_ACCESS_SPI_SDHC=y
CONFIG_DISK_SDHC_VOLUME_NAME="SD"
CONFIG_FILE_SYSTEM=y
CONFIG_FAT_FILESYSTEM_ELM=y

# Use the Laird Connectivity Zephyr Library
CONFIG_COMPONENT_LIB=y

#NFC Support
CONFIG_LCZ_NFC=y
```

## include/app_version.h
```c
/**
 * @file app_version.h
 * @brief
 *
 * Copyright (c) 2020 Laird Connectivity
 *
 * SPDX-License-Identifier: Apache-2.0
 */
#ifndef __APP_VERSION_H__
#define __APP_VERSION_H__

#ifdef __cplusplus
extern "C" {
#endif

/******************************************************************************/
/* Application Firmware Version                                               */
/******************************************************************************/
#define APP_VERSION_MAJOR 3
#define APP_VERSION_MINOR 0

#define APP_VERSION_PATCH 103

#define APP_VERSION_STRING                                                     \
	STRINGIFY(APP_VERSION_MAJOR)                                           \
	"." STRINGIFY(APP_VERSION_MINOR) "." STRINGIFY(APP_VERSION_PATCH)

#ifdef __cplusplus
}
#endif

#endif /* __APP_VERSION_H__ */
```

## include/aws.h
```c
/**
 * @file aws.h
 * @brief Amazon Web Services API
 *
 * Copyright (c) 2020 Laird Connectivity
 *
 * SPDX-License-Identifier: Apache-2.0
 */
#ifndef __AWS_H__
#define __AWS_H__

/******************************************************************************/
/* Includes                                                                   */
/******************************************************************************/
#include <data/json.h>

#include "lairdconnect_battery.h"
#include "ble_motion_service.h"
#include "sdcard_log.h"

#ifdef __cplusplus
extern "C" {
#endif

/******************************************************************************/
/* Global Constants, Macros and Type Definitions                              */
/******************************************************************************/
/* AWS Root CA obtained from
*  https://docs.aws.amazon.com/iot/latest/developerguide/managing-device-certs.html
*/
static const unsigned char aws_root_ca[] =
	"-----BEGIN CERTIFICATE-----\n"
	"MIIDQTCCAimgAwIBAgITBmyfz5m/jAo54vB4ikPmljZbyjANBgkqhkiG9w0BAQsF\n"
	"ADA5MQswCQYDVQQGEwJVUzEPMA0GA1UEChMGQW1hem9uMRkwFwYDVQQDExBBbWF6\n"
	"b24gUm9vdCBDQSAxMB4XDTE1MDUyNjAwMDAwMFoXDTM4MDExNzAwMDAwMFowOTEL\n"
	"MAkGA1UEBhMCVVMxDzANBgNVBAoTBkFtYXpvbjEZMBcGA1UEAxMQQW1hem9uIFJv\n"
	"b3QgQ0EgMTCCASIwDQYJKoZIhvcNAQEBBQADggEPADCCAQoCggEBALJ4gHHKeNXj\n"
	"ca9HgFB0fW7Y14h29Jlo91ghYPl0hAEvrAIthtOgQ3pOsqTQNroBvo3bSMgHFzZM\n"
	"9O6II8c+6zf1tRn4SWiw3te5djgdYZ6k/oI2peVKVuRF4fn9tBb6dNqcmzU5L/qw\n"
	"IFAGbHrQgLKm+a/sRxmPUDgH3KKHOVj4utWp+UhnMJbulHheb4mjUcAwhmahRWa6\n"
	"VOujw5H5SNz/0egwLX0tdHA114gk957EWW67c4cX8jJGKLhD+rcdqsq08p8kDi1L\n"
	"93FcXmn/6pUCyziKrlA4b9v7LWIbxcceVOF34GfID5yHI9Y/QCB/IIDEgEw+OyQm\n"
	"jgSubJrIqg0CAwEAAaNCMEAwDwYDVR0TAQH/BAUwAwEB/zAOBgNVHQ8BAf8EBAMC\n"
	"AYYwHQYDVR0OBBYEFIQYzIU07LwMlJQuCFmcx7IQTgoIMA0GCSqGSIb3DQEBCwUA\n"
	"A4IBAQCY8jdaQZChGsV2USggNiMOruYou6r4lK5IpDB/G/wkjUu0yKGX9rbxenDI\n"
	"U5PMCCjjmCXPI6T53iHTfIUJrU6adTrCC2qJeHZERxhlbI1Bjjt/msv0tadQ1wUs\n"
	"N+gDS63pYaACbvXy8MWy7Vu33PqUXHeeE6V/Uq2V8viTO96LXFvKWlJbYK8U90vv\n"
	"o/ufQJVtMVT8QtPHRh8jrdkPSHCa2XV4cdFyQzR1bldZwgJcJmApzyMZFo6IQ6XU\n"
	"5MsI+yMRQ+hDKXJioaldXgjUkK642M4UwtBV8ob2xJNDd2ZhwLnoQdeXeGADbkpy\n"
	"rqXRfboQnoZsG4q5WTP468SQvvG5\n"
	"-----END CERTIFICATE-----\n";

#define AWS_DEFAULT_ENDPOINT "a3273rvo818l4w-ats.iot.us-east-1.amazonaws.com"

#define SERVER_PORT_STR "8883"

#define ATT_DEFAULT_ENDPOINT "runm-west.dataflow.iot.att.com"

#define ATT_SERVER_PORT_STR "12200"

#define APP_SLEEP_MSECS 500

#define PUBLISH_TIMEOUT_TICKS K_SECONDS(5)

#define APP_CONNECT_TRIES 1

#define APP_MQTT_BUFFER_SIZE 1024

#define DEFAULT_MQTT_CLIENTID "mg100"
#define AWS_MQTT_ID_MAX_SIZE 128

#define SHADOW_STATE_NULL "{\"state\":null}"
#define SHADOW_REPORTED_START "{\"state\":{\"reported\":{"
#define SHADOW_REPORTED_END "}}}"
#define SHADOW_TEMPERATURE "\"temperature\":"
#define SHADOW_HUMIDITY "\"humidity\":"
#define SHADOW_PRESSURE "\"pressure\":"
#define SHADOW_RADIO_RSSI "\"radio_rssi\":"
#define SHADOW_RADIO_SINR "\"radio_sinr\":"
#define SHADOW_TEMPERATURE "\"temperature\":"
#define SHADOW_HUMIDITY "\"humidity\":"
#define SHADOW_PRESSURE "\"pressure\":"
#define SHADOW_RADIO_RSSI "\"radio_rssi\":"
#define SHADOW_RADIO_SINR "\"radio_sinr\":"
#define SHADOW_MG100_TEMP "\"tempC\":"
#define SHADOW_MG100_BATT_LEVEL "\"batteryLevel\":"
#define SHADOW_MG100_BATT_VOLT "\"batteryVoltageMv\":"
#define SHADOW_MG100_PWR_STATE "\"powerState\":"
#define SHADOW_MG100_BATT_LOW "\"batteryLowThreshold\":"
#define SHADOW_MG100_BATT_0 "\"battery0\":"
#define SHADOW_MG100_BATT_1 "\"battery1\":"
#define SHADOW_MG100_BATT_2 "\"battery2\":"
#define SHADOW_MG100_BATT_3 "\"battery3\":"
#define SHADOW_MG100_BATT_4 "\"battery4\":"
#define SHADOW_MG100_BATT_GOOD "\"batteryGood\":"
#define SHADOW_MG100_BATT_BAD "\"batteryBadThreshold\":"
#define SHADOW_MG100_ODR "\"odr\":"
#define SHADOW_MG100_SCALE "\"scale\":"
#define SHADOW_MG100_ACT_THS "\"activationThreshold\":"
#define SHADOW_MG100_MOVEMENT "\"movement\":"
#define SHADOW_MG100_MAX_LOG_SIZE "\"maxLogSizeMB\":"
#define SHADOW_MG100_SDCARD_FREE "\"sdCardFreeMB\":"
#define SHADOW_MG100_CURR_LOG_SIZE "\"logSizeMB\":"

#define AWS_RX_THREAD_STACK_SIZE 4096
#define AWS_RX_THREAD_PRIORITY K_PRIO_COOP(15)

#define GATEWAY_TOPIC NULL

#define CLEAR_SHADOW_ON_STARTUP 0

struct shadow_persistent_values {
	const char *firmware_version;
	const char *os_version;
	const char *radio_version;
	const char *IMEI;
	const char *ICCID;
	const char *radio_sn;
	bool codedPhySupported;
};

struct shadow_state_reported {
	struct shadow_persistent_values reported;
};

struct shadow_reported_struct {
	struct shadow_state_reported state;
};

static const struct json_obj_descr shadow_persistent_values_descr[] = {
	JSON_OBJ_DESCR_PRIM(struct shadow_persistent_values, firmware_version,
			    JSON_TOK_STRING),
	JSON_OBJ_DESCR_PRIM(struct shadow_persistent_values, os_version,
			    JSON_TOK_STRING),
	JSON_OBJ_DESCR_PRIM(struct shadow_persistent_values, radio_version,
			    JSON_TOK_STRING),
	JSON_OBJ_DESCR_PRIM(struct shadow_persistent_values, IMEI,
			    JSON_TOK_STRING),
	JSON_OBJ_DESCR_PRIM(struct shadow_persistent_values, ICCID,
			    JSON_TOK_STRING),
	JSON_OBJ_DESCR_PRIM(struct shadow_persistent_values, radio_sn,
			    JSON_TOK_STRING),
	JSON_OBJ_DESCR_PRIM(struct shadow_persistent_values, codedPhySupported,
			    JSON_TOK_TRUE),
};

static const struct json_obj_descr shadow_state_reported_descr[] = {
	JSON_OBJ_DESCR_OBJECT(struct shadow_state_reported, reported,
			      shadow_persistent_values_descr),
};

static const struct json_obj_descr shadow_descr[] = {
	JSON_OBJ_DESCR_OBJECT(struct shadow_reported_struct, state,
			      shadow_state_reported_descr),
};

/******************************************************************************/
/* Global Function Prototypes                                                 */
/******************************************************************************/
int awsInit(void);
int awsSetCredentials(const uint8_t *cert, const uint8_t *key);
void awsSetRootCa(const char *cred);
void awsSetEndpoint(const char *ep);
void awsSetClientId(const char *id);
int awsGetServerAddr(void);
int awsConnect(void);
bool awsConnected(void);
void awsDisconnect(void);
int awsKeepAlive(void);
int awsSendData(char *data, uint8_t *topic);
int awsPublishShadowPersistentData(void);
int awsSetShadowKernelVersion(const char *version);
int awsSetShadowIMEI(const char *imei);
int awsSetShadowICCID(const char *iccid);
int awsSetShadowRadioSerialNumber(const char *sn);
int awsSetShadowRadioFirmwareVersion(const char *version);
int awsSetShadowAppFirmwareVersion(const char *version);
int awsPublishBl654SensorData(float temperature, float humidity,
			      float pressure);
int awsPublishPinnacleData(int radioRssi, int radioSinr,
			   struct battery_data *battery,
			   struct motion_status *motion,
			   struct sdcard_status *sdcard);
int awsSubscribe(uint8_t *topic, uint8_t subscribe);
int awsGetShadow(void);
int awsGetAcceptedSubscribe(void);
int awsGetAcceptedUnsub(void);
void awsGenerateGatewayTopics(const char *imei);
void awsDisconnectCallback(void);
char *awsGetGatewayUpdateDeltaTopic(void);

#ifdef __cplusplus
}
#endif

#endif /* __AWS_H__ */
```

## src/ble_motion_service.c
```c
/**
 * @file ble_motion_service.c
 * @brief
 *
 * Copyright (c) 2020 Laird Connectivity
 *
 * SPDX-License-Identifier: Apache-2.0
 */

#include <logging/log.h>
#include <drivers/sensor.h>

#define LOG_LEVEL LOG_LEVEL_DBG
LOG_MODULE_REGISTER(mg100_motion_svc);

#define MOTION_SVC_LOG_ERR(...) LOG_ERR(__VA_ARGS__)
#define MOTION_SVC_LOG_WRN(...) LOG_WRN(__VA_ARGS__)
#define MOTION_SVC_LOG_INF(...) LOG_INF(__VA_ARGS__)
#define MOTION_SVC_LOG_DBG(...) LOG_DBG(__VA_ARGS__)

#define MOTION_ALARM_ACTIVE		1
#define MOTION_ALARM_INACTIVE   0
#define INACTIVITY_TIMER_PERIOD K_MSEC(30000)

/******************************************************************************/
/* Includes                                                                   */
/******************************************************************************/
#include <bluetooth/uuid.h>
#include <bluetooth/gatt.h>
#include <bluetooth/bluetooth.h>

#include "laird_bluetooth.h"
#include "ble_motion_service.h"
#include "nv.h"

/******************************************************************************/
/* Local Constant, Macro and Type Definitions                                 */
/******************************************************************************/
#define MOTION_SVC_BASE_UUID_128(_x_)                                           \
	BT_UUID_INIT_128(0x66, 0x9a, 0x0c, 0x20, 0x00, 0x08, 0x6e, 0x8b, 0xea, 0x11, \
			0x1a, 0xac, LSB_16(_x_), MSB_16(_x_), 0xce, 0xad)

static struct bt_uuid_128 MOTION_SVC_UUID = MOTION_SVC_BASE_UUID_128(0x0a30);
static struct bt_uuid_128 MOTION_ALARM_UUID = MOTION_SVC_BASE_UUID_128(0x0a31);

struct ble_motion_service {
	u16_t motion_alarm_index;
	u8_t motion_alarm;
};

struct ccc_table {
	struct lbt_ccc_element motion_alarm;
};

/******************************************************************************/
/* Local Data Definitions                                                     */
/******************************************************************************/
static struct ble_motion_service bms;
static struct ccc_table ccc;
static struct bt_conn *motion_svc_conn;
static struct k_timer motion_timer;
static struct motion_status motionStatus;

/* This array maps ODR values to real sampling frequency values. To keep the
 * implementation common between various Laird Connectivity products for the
 * device shadow, we present ODR values rather than the real sampling frequency
 * values. However, the sensor framework expects the real sampling frequency
 * values. This mapping was copied from the ST LIS2DH driver in Zephyr which
 * translates these back into ODR values. These are the supported sampling
 * frequency / ODR settings supported by the ST LISxDH parts.
 */
static uint16_t lis2dh_odr_map[] = {0, 1, 10, 25, 50, 100, 200, 400, 1620,
			    1344, 5376};

/******************************************************************************/
/* Local Function Prototypes                                                  */
/******************************************************************************/
static void motion_alarm_ccc_handler(const struct bt_gatt_attr *attr,
					u16_t value);
static void motion_sensor_trig_handler(struct device *dev,
					struct sensor_trigger *trigger);
static void motion_timer_callback(struct k_timer *timer_id);
static void motion_svc_connected(struct bt_conn *conn, uint8_t err);
static void motion_svc_disconnected(struct bt_conn *conn, uint8_t reason);

/******************************************************************************/
/* Motion Service Declaration                                                 */
/******************************************************************************/
static struct bt_conn_cb motion_svc_conn_callbacks = {
	.connected = motion_svc_connected,
	.disconnected = motion_svc_disconnected,
};

static struct bt_gatt_attr motion_attrs[] = {
	BT_GATT_PRIMARY_SERVICE(&MOTION_SVC_UUID),
	BT_GATT_CHARACTERISTIC(
		&MOTION_ALARM_UUID.uuid, BT_GATT_CHRC_NOTIFY,
		BT_GATT_PERM_NONE, NULL, NULL, &bms.motion_alarm),
	LBT_GATT_CCC(motion_alarm)
};

static struct bt_gatt_service motion_svc = BT_GATT_SERVICE(motion_attrs);
static struct device *sensor = NULL;
/******************************************************************************/
/* Global Function Definitions                                                */
/******************************************************************************/
static void motion_svc_connected(struct bt_conn *conn, uint8_t err)
{
	if (err) {
		return;
	}

	if (!lbt_slave_role(conn)) {
		return;
	}

	motion_svc_conn = bt_conn_ref(conn);
}

static void motion_svc_disconnected(struct bt_conn *conn, uint8_t reason)
{
	if (!lbt_slave_role(conn)) {
		return;
	}

	if (motion_svc_conn) {
		bt_conn_unref(motion_svc_conn);
		motion_svc_conn = NULL;
	}
}

/* The weak implementation can be used for single peripheral designs. */
__weak struct bt_conn *motion_svc_get_conn(void)
{
	return motion_svc_conn;
}

bool UpdateOdr(int Value)
{
	bool ret = true;
	int Status = 0;
	struct sensor_value sVal;

	sVal.val1 = lis2dh_odr_map[Value];
	sVal.val2 = 0;

	Status = sensor_attr_set(sensor, SENSOR_CHAN_ACCEL_XYZ, SENSOR_ATTR_SAMPLING_FREQUENCY, &sVal);
	nvStoreAccelODR(Value);

	LOG_DBG("ODR = %d, Status = %d", Value, Status);

	return(ret);
}

bool UpdateScale(int Value)
{
	bool ret = true;
	int Status = 0;

	struct sensor_value sVal;

	sensor_g_to_ms2(Value, &sVal);
	Status = sensor_attr_set(sensor, SENSOR_CHAN_ACCEL_XYZ, SENSOR_ATTR_FULL_SCALE, &sVal);

	nvStoreAccelScale(Value);

	LOG_DBG("Scale = %d, Status = %d", Value, Status);

	return(ret);
}

bool UpdateActivityThreshold(int Value)
{
	bool ret = true;
	int Status = 0;
	struct sensor_value sVal;

	sVal.val1 = Value;
	sVal.val2 = 0;

	Status = sensor_attr_set(sensor, SENSOR_CHAN_ACCEL_XYZ, SENSOR_ATTR_SLOPE_TH, &sVal);
	nvStoreAccelThresh(Value);

	LOG_DBG("Activity Threshold = %d, Status = %d", Value, Status);

	return(ret);
}

int GetOdr()
{
	int Value = 0;
	nvReadAccelODR(&Value);

	return (Value);
}

int GetScale()
{
	int Value = 0;
	nvReadAccelScale(&Value);

	return (Value);
}

int GetActivityThreshold()
{
	int Value = 0;
	nvReadAccelThresh(&Value);

	return (Value);
}

struct motion_status *motionGetStatus()
{
	motionStatus.motion = bms.motion_alarm;
	motionStatus.scale = GetScale();
	motionStatus.odr = GetOdr();
	motionStatus.thr = GetActivityThreshold();

	return (&motionStatus);
}

static void motion_svc_notify(bool notify, u16_t index, u16_t length)
{
	struct bt_conn *connection_handle = motion_svc_get_conn();
	if (connection_handle != NULL) {
		if (notify) {
			bt_gatt_notify(connection_handle,
				       &motion_svc.attrs[index],
				       motion_svc.attrs[index].user_data,
				       length);
		}
	}
}

void motion_svc_set_alarm_state(u8_t alarmState)
{
	bms.motion_alarm = alarmState;
	motion_svc_notify(ccc.motion_alarm.notify, bms.motion_alarm_index,
			 sizeof(bms.motion_alarm));
}

void motion_svc_init()
{
	struct sensor_trigger trigger;
	struct sensor_value sVal;
	int status = 0;

	sensor = device_get_binding(DT_LABEL(DT_INST(0, st_lis2dh)));
	bms.motion_alarm = MOTION_ALARM_INACTIVE;

	bt_gatt_service_register(&motion_svc);
	bt_conn_cb_register(&motion_svc_conn_callbacks);

	size_t gatt_size = (sizeof(motion_attrs) / sizeof(motion_attrs[0]));
	bms.motion_alarm_index = lbt_find_gatt_index(&MOTION_ALARM_UUID.uuid, motion_attrs,
						gatt_size);

	k_timer_init(&motion_timer, motion_timer_callback, NULL);

	/* configure the sensor */

	/* NOTE: the zephyr sensor framework expects a frequency value rather than ODR value directly */
	sVal.val1 = lis2dh_odr_map[GetOdr()];
	sVal.val2 = 0;
	status = sensor_attr_set(sensor, SENSOR_CHAN_ACCEL_XYZ, SENSOR_ATTR_SAMPLING_FREQUENCY, &sVal);
	if (status < 0)
	{
		MOTION_SVC_LOG_ERR("Failed to set ODR in the accelerometer.");
	}

	/* configure the scale */
	/* NOTE: the zephyr sensor framework expects a value in m/S^2: 9.80665 m/s^2 = 1G */
	sensor_g_to_ms2(GetScale(), &sVal);
	status = sensor_attr_set(sensor, SENSOR_CHAN_ACCEL_XYZ, SENSOR_ATTR_FULL_SCALE, &sVal);
	if (status < 0)
	{
		MOTION_SVC_LOG_ERR("Failed to set the scale in the accelerometer.");
	}

	/* configure the threshold value */
	sVal.val1 = GetActivityThreshold();
	sVal.val2 = 0;
	status = sensor_attr_set(sensor, SENSOR_CHAN_ACCEL_XYZ, SENSOR_ATTR_SLOPE_TH, &sVal);
	if (status < 0)
	{
		MOTION_SVC_LOG_ERR("Failed to set the threshold in the accelerometer.");
	}

	/* configure the duration value */
	sVal.val1 = MOTION_DEFAULT_DUR;
	sVal.val2 = 0;
	status = sensor_attr_set(sensor, SENSOR_CHAN_ACCEL_XYZ, SENSOR_ATTR_SLOPE_DUR, &sVal);
	if (status < 0)
	{
		MOTION_SVC_LOG_ERR("Failed to set the duration in the accelerometer.");
	}

	/* configure the motion trigger */
	trigger.chan = SENSOR_CHAN_ACCEL_XYZ;
	trigger.type = SENSOR_TRIG_DELTA;
	status = sensor_trigger_set(sensor, &trigger, motion_sensor_trig_handler);
	if (status < 0)
	{
		MOTION_SVC_LOG_ERR("Failed to configure the trigger for the accelerometer.");
	}
}

/******************************************************************************/
/* Local Function Definitions                                                 */
/******************************************************************************/
static void motion_alarm_ccc_handler(const struct bt_gatt_attr *attr, u16_t value)
{
	ccc.motion_alarm.notify = IS_NOTIFIABLE(value);
}

static void motion_timer_callback(struct k_timer *timer_id)
{
	k_timer_stop(&motion_timer);
	motion_svc_set_alarm_state(MOTION_ALARM_INACTIVE);
}

void motion_sensor_trig_handler(struct device *dev,
					 struct sensor_trigger *trigger)
{
	k_timer_stop(&motion_timer);
	motion_svc_set_alarm_state(MOTION_ALARM_ACTIVE);
	k_timer_start(&motion_timer, INACTIVITY_TIMER_PERIOD,
				INACTIVITY_TIMER_PERIOD);
	MOTION_SVC_LOG_DBG("Movement of the gateway detected.");
}
```

## src/sdcard_log.c
```c
/**
 * @file sdcard_log.c
 * @brief
 *
 * Copyright (c) 2020 Laird Connectivity
 *
 * SPDX-License-Identifier: Apache-2.0
 */

#include <logging/log.h>
#define LOG_LEVEL LOG_LEVEL_DBG
LOG_MODULE_REGISTER(sdcard_log);

/******************************************************************************/
/* Includes                                                                   */
/******************************************************************************/
#include <devicetree.h>
#include <disk/disk_access.h>
#include <fs/fs.h>
#include <drivers/gpio.h>
#include <ff.h>
#include <stdio.h>
#include <string.h>
#include "FrameworkIncludes.h"
#include "nv.h"
#include "sdcard_log.h"
#include "qrtc.h"

#ifdef CONFIG_BLUEGRASS
# include "sensor_log.h"
#endif
/******************************************************************************/
/* Local Constant, Macro and Type Definitions                                 */
/******************************************************************************/
#define SD_OE_PORT				DT_PROP(DT_NODELABEL(gpio0), label)
#define SD_OE_PIN				4
#define SD_OE_ENABLED			1
#define SD_OE_DISABLED			0

#define TIMESTAMP_LEN			10
#define FMT_CHAR_LEN			3
#define EVENT_MAX_STR_LEN		128
#define EVENT_FMT_CHAR_LEN		5

#define B_PER_KB				1024
#define KB_PER_MB				1024
#define B_PER_MB				(B_PER_KB * KB_PER_MB)
/******************************************************************************/
/* Global Data Definitions                                                    */
/******************************************************************************/

/******************************************************************************/
/* Local Data Definitions                                                     */
/******************************************************************************/
static FATFS fat_fs;
static struct fs_mount_t mp = {
	.type = FS_FATFS,
	.fs_data = &fat_fs,
};

static const char *mountPoint = "/SD:";
static const char *batteryFilePath = "/SD:/mg100B.csv";
static const char *sensorFilePath = "/SD:/mg100Ad.csv";
static const char *bl654FilePath = "/SD:/mg100bl6.csv";

static bool sdCardPresent = false;
static struct fs_file_t batteryLogZfp;
static int batteryLogSeekOffset = 0;
static int batteryLogMaxLength = SDCARD_LOG_DEFAULT_MAX_LENGTH * B_PER_MB;
static bool batteryLogFileOpened = false;
static int sensorLogMaxLength = SDCARD_LOG_DEFAULT_MAX_LENGTH * B_PER_MB;
static int bl654LogMaxLength = SDCARD_LOG_DEFAULT_MAX_LENGTH * B_PER_MB;
static struct sdcard_status sdCardLogStatus;

#ifdef CONFIG_BLUEGRASS
static struct fs_file_t sensorLogFileZfp;
static int sensorLogSeekOffset = 0;
static bool sensorLogFileOpened = false;
static struct fs_file_t bl654LogFileZfp;
static int bl654LogSeekOffset = 0;
static bool bl654LogFileOpened = false;
#endif

/******************************************************************************/
/* Local Function Prototypes                                                  */
/******************************************************************************/

/******************************************************************************/
/* Global Function Definitions                                                */
/******************************************************************************/
struct sdcard_status *sdCardLogGetStatus()
{
	sdCardLogStatus.currLogSize = GetLogSize();
	sdCardLogStatus.maxLogSize = GetMaxLogSize();
	sdCardLogStatus.freeSpace = GetFSFree();

	return (&sdCardLogStatus);
}
bool UpdateMaxLogSize(int Value)
{
	bool ret = true;
	int ValueB = Value * B_PER_MB;
	sensorLogMaxLength = ValueB;
	bl654LogMaxLength = ValueB;
	batteryLogMaxLength = ValueB;
	nvStoreSDLogMaxSize(Value);
	LOG_INF("Max log file size = %d MB", Value);

	return (ret);
}

int GetMaxLogSize()
{
	int LengthB = sensorLogMaxLength / B_PER_MB;
	return(LengthB);
}

int GetFSFree()
{
	struct fs_statvfs Stats;
	unsigned long FreeSpace = 0;
	int Status = 0;
	int Ret = -1;

	if (sdCardPresent == true)
	{
		Status = fs_statvfs(mountPoint, &Stats);

		if (Status == 0)
		{
			FreeSpace = Stats.f_bfree * Stats.f_frsize;
			/* always round up 1MB */
			Ret = (FreeSpace / B_PER_MB) + 1;
		}
	}


	return (Ret);
}

int GetLogSize()
{
	struct fs_dirent fileStat;
	int LogSize = 0;
	int Status = 0;
	int Ret = -1;

	if (sdCardPresent == true)
	{
		Status = fs_stat(bl654FilePath, &fileStat);
		if (Status == 0)
		{
			LogSize += fileStat.size;
		}
		Status = fs_stat(sensorFilePath, &fileStat);
		if (Status == 0)
		{
			LogSize += fileStat.size;
		}
		Status = fs_stat(batteryFilePath, &fileStat);
		if (Status == 0)
		{
			LogSize += fileStat.size;
		}
		/* always round up */
		Ret = (LogSize / B_PER_MB) + 1;
	}

	return (Ret);
}

int sdCardLogInit()
{
	int ret = 0;
	int LogLength = 0;
	u32_t blockCount = 0;
	u32_t blockSize = 0;
	u64_t sdCardSize = 0;
	static const char *diskPdrv = "SD";
	struct device * sdcardEnable = 0;

	/* initialize the log size based on the stored log size */
	ret = nvReadSDLogMaxSize(&LogLength);


	/* if nothing valid is present just set it to a default value */
	if ((ret < 0) || (LogLength < SDCARD_LOG_DEFAULT_MAX_LENGTH))
	{
		LogLength = SDCARD_LOG_DEFAULT_MAX_LENGTH;
	}

	UpdateMaxLogSize(LogLength);

	/* enable the voltage translator between the nRF52 and SD card */
	sdcardEnable = device_get_binding(SD_OE_PORT);
	gpio_pin_configure(sdcardEnable, SD_OE_PIN, GPIO_OUTPUT);
	gpio_pin_set(sdcardEnable, SD_OE_PIN, SD_OE_ENABLED);

	do
	{

		ret = disk_access_init(diskPdrv);
		if (ret != 0) {
			LOG_ERR("Storage init error = %d", ret);
			break;
		}

		ret = disk_access_ioctl(diskPdrv,
				DISK_IOCTL_GET_SECTOR_COUNT, &blockCount);
		if (ret) {
			LOG_ERR("Unable to get block count, error = %d", ret);
			break;
		}
		LOG_INF("Block count %u", blockCount);

		ret = disk_access_ioctl(diskPdrv,
				DISK_IOCTL_GET_SECTOR_SIZE, &blockSize);
		if (ret) {
			LOG_ERR("Unable to get block size, error = %d", ret);
			break;
		}
		LOG_INF("Block size %u\n", blockSize);

		sdCardSize = (u64_t)blockCount * blockSize;
		LOG_INF("Memory Size(MB) %u\n", (u32_t)sdCardSize>>20);

		mp.mnt_point = mountPoint;

		ret = fs_mount(&mp);

		if (ret == 0) {
			LOG_INF("Disk mounted.\n");
			sdCardPresent = true;
		} else {
			LOG_ERR("Error mounting disk.\n");
		}
	} while(0);

	return ret;
}

#ifdef CONFIG_BLUEGRASS
int sdCardLogBL654Data(BL654SensorMsg_t * msg)
{
	int ret = -ENODEV;
	int totalLength = 0;
	char * logData = 0;
	struct fs_dirent fileStat;

	if (sdCardPresent)
	{
		/* if this is the first open, we want to
		*	be sure to append to the end rather than overwrite from
		*	the beginning.
		*/
		if (bl654LogFileOpened == false)
		{
			ret = fs_stat(bl654FilePath, &fileStat);
			if (ret == 0)
			{
				bl654LogSeekOffset = fileStat.size;
				bl654LogFileOpened = true;
			}
		}

		/* open and close the file every time to help ensure integrity
		*	of the file system if power were to be lost in between writes.
		*/
		ret = fs_open(&bl654LogFileZfp, bl654FilePath);
		if (ret >= 0)
		{
			totalLength = EVENT_MAX_STR_LEN + EVENT_FMT_CHAR_LEN;
			logData = k_malloc(totalLength);
			if(logData > 0)
			{
				/* find the end of the file */
				ret = fs_seek(&bl654LogFileZfp, bl654LogSeekOffset, 0);

				/* only try to write if the seek succeeded. */
				if (ret >= 0)
				{
					/* append the timestamp and data */
					snprintf(logData, totalLength, "%d,%d,%d,%d\n", Qrtc_GetEpoch(), (u32_t)(msg->temperatureC * 100),
								(u32_t)(msg->humidityPercent * 100), (u32_t)(msg->pressurePa * 10));

					ret = fs_write(&bl654LogFileZfp, logData, strlen(logData));

					/* only update the offset if the write succeeded. */
					if (ret >= 0)
					{
						bl654LogSeekOffset += strlen(logData);
						/* treat this as a circular buffer to limit log file growth */
						if (bl654LogSeekOffset > bl654LogMaxLength)
						{
							bl654LogSeekOffset = 0;
						}
					}
				}
				k_free(logData);
				logData = 0;
			}
			/* close the file (this also flushes data to the physical media) */
			ret = fs_close(&bl654LogFileZfp);
		}
	}

	return ret;
}
int sdCardLogAdEvent(Bt510AdEvent_t * event)
{
	int ret = 0;
	int totalLength = 0;
	char * logData = 0;
	struct fs_dirent fileStat;
	char bleAddrStr[BT_ADDR_STR_LEN];

	if (sdCardPresent)
	{
		/* if this is the first open, we want to
		*	be sure to append to the end rather than overwrite from
		*	the beginning.
		*/
		if (sensorLogFileOpened == false)
		{
			ret = fs_stat(sensorFilePath, &fileStat);
			if (ret == 0)
			{
				sensorLogSeekOffset = fileStat.size;
				sensorLogFileOpened = true;
			}
		}

		/* open and close the file every time to help ensure integrity
		*	of the file system if power were to be lost in between writes.
		*/
		ret = fs_open(&sensorLogFileZfp, sensorFilePath);
		if (ret >= 0)
		{
			totalLength = EVENT_MAX_STR_LEN + EVENT_FMT_CHAR_LEN + BT_ADDR_STR_LEN;
			logData = k_malloc(totalLength);
			if(logData > 0)
			{
				/* find the end of the file */
				ret = fs_seek(&sensorLogFileZfp, sensorLogSeekOffset, 0);

				/* only try to write if the seek succeeded. */
				if (ret >= 0)
				{
					/* append the timestamp and data */
					bt_addr_to_str(&event->addr, bleAddrStr, sizeof(bleAddrStr));
					snprintf(logData, totalLength, "%s,%d,%d,%d,%d\n", bleAddrStr, event->epoch,
								event->recordType, event->id, event->data);
					ret = fs_write(&sensorLogFileZfp, logData, strlen(logData));

					/* only update the offset if the write succeeded. */
					if (ret >= 0)
					{
						sensorLogSeekOffset += strlen(logData);
						/* treat this as a circular buffer to limit log file growth */
						if (sensorLogSeekOffset > sensorLogMaxLength)
						{
							sensorLogSeekOffset = 0;
						}
					}
				}
				k_free(logData);
				logData = 0;
			}
			/* close the file (this also flushes data to the physical media) */
			ret = fs_close(&sensorLogFileZfp);
		}
	}

	return ret;
}
#endif
int sdCardLogBatteryData(void * data, int length)
{
	int ret = 0;
	int totalLength = 0;
	char * logData = 0;
	struct fs_dirent fileStat;

	if (sdCardPresent)
	{
		/* if this is the first open, we want to
		*	be sure to append to the end rather than overwrite from
		*	the beginning.
		*/
		if (batteryLogFileOpened == false)
		{
			ret = fs_stat(batteryFilePath, &fileStat);
			if (ret == 0)
			{
				batteryLogSeekOffset = fileStat.size;
				batteryLogFileOpened = true;
			}
		}

		/* open and close the file every time to help ensure integrity
		*	of the file system if power were to be lost in between writes.
		*/
		ret = fs_open(&batteryLogZfp, batteryFilePath);
		if (ret >= 0)
		{
			totalLength = length + TIMESTAMP_LEN + FMT_CHAR_LEN;
			logData = k_malloc(totalLength);
			if(logData > 0)
			{
				/* find the end of the file */
				ret = fs_seek(&batteryLogZfp, batteryLogSeekOffset, 0);

				/* only try to write if the seek succeeded. */
				if (ret >= 0)
				{
					/* append the timestamp and data */
					snprintk(logData, totalLength, "%d,%s\n", Qrtc_GetEpoch(), (char *)data);
					ret = fs_write(&batteryLogZfp, logData, strlen(logData));

					/* only update the offset if the write succeeded. */
					if (ret >= 0)
					{
						batteryLogSeekOffset += strlen(logData);
						/* treat this as a circular buffer to limit log file growth */
						if (batteryLogSeekOffset > batteryLogMaxLength)
						{
							batteryLogSeekOffset = 0;
						}
					}
				}
				k_free(logData);
				logData = 0;
			}
			/* close the file (this also flushes) */
			ret = fs_close(&batteryLogZfp);
		}
	}

	return ret;
}
```
